#include "modbus_rtu_master.h"

extern uint8_t rx_flag;
static uint16_t usMBCRC16( uint8_t * pucFrame, uint16_t usLen )
{
    static const uint8_t aucCRCHi[] =
    {
        0x00, 0xC1, 0x81, 0x40, 0x01, 0xC0, 0x80, 0x41, 0x01, 0xC0, 0x80, 0x41,
        0x00, 0xC1, 0x81, 0x40, 0x01, 0xC0, 0x80, 0x41, 0x00, 0xC1, 0x81, 0x40,
        0x00, 0xC1, 0x81, 0x40, 0x01, 0xC0, 0x80, 0x41, 0x01, 0xC0, 0x80, 0x41,
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        0x00, 0xC1, 0x81, 0x40
    };

    static const uint8_t aucCRCLo[] =
    {
        0x00, 0xC0, 0xC1, 0x01, 0xC3, 0x03, 0x02, 0xC2, 0xC6, 0x06, 0x07, 0xC7,
        0x05, 0xC5, 0xC4, 0x04, 0xCC, 0x0C, 0x0D, 0xCD, 0x0F, 0xCF, 0xCE, 0x0E,
        0x0A, 0xCA, 0xCB, 0x0B, 0xC9, 0x09, 0x08, 0xC8, 0xD8, 0x18, 0x19, 0xD9,
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        0x41, 0x81, 0x80, 0x40
    };

    uint8_t           ucCRCHi = 0xFF;
    uint8_t           ucCRCLo = 0xFF;
    int             iIndex;

    while( usLen-- )
    {
        iIndex = ucCRCLo ^ *( pucFrame++ );
        ucCRCLo = ( uint8_t )( ucCRCHi ^ aucCRCHi[iIndex] );
        ucCRCHi = aucCRCLo[iIndex];
    }
    return ( uint16_t )( ucCRCHi << 8 | ucCRCLo );
}

static int CheckCrcOK(const uint8_t* buf, uint32_t len)
{
    uint16_t chechcrc,checksum;
    chechcrc = (buf[len - 1] << 8) | buf[len - 2];
    checksum = usMBCRC16((uint8_t *)buf, len - 2);
    if(chechcrc != checksum)
    {
        return 0;
    }
    return 1;
}


static uint32_t MBRTUMasterRead(MBRTUMaterTypeDef* pMaster, uint8_t ucSlaveAddr, uint8_t ucCmd, uint16_t usStartAddr, uint16_t usNum)
{
    uint16_t crc;

		pMaster->ucBuf[0] = ucSlaveAddr;
		pMaster->ucBuf[1] = ucCmd;
		pMaster->ucBuf[2] = ((usStartAddr & 0XFF00) >> 8);
		pMaster->ucBuf[3] = (usStartAddr & 0XFF);
		pMaster->ucBuf[4] = ((usNum & 0XFF00) >> 8);
		pMaster->ucBuf[5] = (usNum & 0XFF);

		crc = usMBCRC16( ( uint8_t * )pMaster->ucBuf, 6);
		pMaster->ucBuf[6] = ( uint8_t )( crc & 0xFF );
		pMaster->ucBuf[7] = ( uint8_t )( crc >> 8 );
//for(int i = 0;i<8;i++)
//{
//	printf("0x%x\r\n",pMaster->ucBuf[i]);
//}
    return pMaster->sendData(pMaster->ucBuf, 8);
}

/**
 * 主机读取保持寄存器
 * @param  ucSlaveAddress 从机地址
 * @param  usAddress      要读取的保持寄存器起始地址
 * @param  usNum          要读取的保持寄存器数量
 * @param  usTimeout      超时时间,单位毫秒
 * @param  pusRegBuffer   存储读取到的寄存器值
 * @return                0:成功  <0:执行失败
 */
int MBRTUMasterReadHoldingRegisters(MBRTUMaterTypeDef* psModbus, uint8_t ucSlaveAddress, uint16_t usAddress, uint16_t usNum, uint16_t usTimeout, uint16_t* pusRegBuffer)
{
    int ret = -1;
    MBRTUMasterRead(psModbus, ucSlaveAddress, 0X03, usAddress, usNum);
		
    while(usTimeout != 0)
    {
			if(rx_flag == 1)
			{
				if(psModbus->ucBuf[0] == ucSlaveAddress && psModbus->ucBuf[1] == 0X03 && CheckCrcOK(&psModbus->ucBuf[0], psModbus->rx_len))
				{
//					printf("数据正确\r\n");
						const uint8_t* p = &psModbus->ucBuf[3];
						while(usNum--)
						{
								*pusRegBuffer++ = ((p[0] << 8 ) | p[1]);
								p += 2;
						}
						ret = 0;
				}
				else
				{
					printf("数据错误\r\n");
						ret = -2;
				}
				rx_flag = 0;
				psModbus->rx_len = 0;
				HAL_UART_Receive_DMA(&huart2,psModbus->ucBuf,sizeof(psModbus->ucBuf));
				break;
			}
			else
			{
				usTimeout--;
				psModbus->delayms(1);
			}
    }
    return ret;
}
